## Linux/meta-scholar-risc-v/conf/layer.conf
```bitbake
# We have a conf and classes directory, add to BBPATH
BBPATH .= ":${LAYERDIR}"

# We have recipes-* directories, add to BBFILES
BBFILES += "${LAYERDIR}/recipes-*/*/*.bb \
            ${LAYERDIR}/recipes-*/*/*.bbappend"

BBFILE_COLLECTIONS += "meta-scholar-risc-v"
BBFILE_PATTERN_meta-scholar-risc-v = "^${LAYERDIR}/"
BBFILE_PRIORITY_meta-scholar-risc-v = "6"

LAYERDEPENDS_meta-scholar-risc-v = "core"
LAYERSERIES_COMPAT_meta-scholar-risc-v = "scarthgap"

BBFILE_DYNAMIC += " \\
    meta-polarfire-soc-yocto-bsp:${LAYERDIR}/recipes-kernel/linux/mpfs-linux_%.bbappend \\
"
```
